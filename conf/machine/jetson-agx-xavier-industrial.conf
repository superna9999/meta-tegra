## conf/machine/jetson-agx-xavier-industrial.conf
```bitbake
#@TYPE: Machine
#@NAME: Nvidia Jetson Xavier Industrial
#@DESCRIPTION: Nvidia Jetson Xavier Industrial dev board

require conf/machine/include/tegra194.inc

KERNEL_DEVICETREE ?= "tegra194-p2888-0008-p2822-0000.dtb"
KERNEL_ARGS ?= "console=ttyTCU0,115200 console=tty0 fbcon=map:0"

EMMC_SIZE ?= "31276924928"
EMMC_DEVSECT_SIZE ?= "512"
BOOTPART_SIZE ?= "8388608"
BOOTPART_LIMIT ?= "10485760"
ROOTFSPART_SIZE ?= "30064771072"
ODMDATA ?= "0x9190000"
EMMC_BCT ?= "tegra194-mb1-bct-memcfg-4x-derated-ecc-p2888.cfg"
EMMC_BCT_OVERRIDE ?= "tegra194-memcfg-sw-override.cfg"
NVIDIA_BOARD ?= "t186ref"
PARTITION_LAYOUT_TEMPLATE ?= "flash_l4t_t194_spi_emmc_jaxi.xml"

# extracted from l4t_generate_soc_bup.sh and nvmassflashgen.sh:
TEGRA_FAB = "600"
TEGRA_BOARDSKU = "0008"
TEGRA_BOARDREV = "A.0"
TEGRA_CHIPREV = "2"
TEGRA_BUPGEN_SPECS = "fab=600;boardsku=0008;boardrev=A.0"
```
